## bma220/zephyr/Kconfig
```kconfig
# BMA220 Three Axis Accelerometer configuration options

# SPDX-License-Identifier: Apache-2.0

menuconfig BMA220
	bool "BMA220 Three Axis Accelerometer Family"
	depends on I2C
	help
	  Enable driver for BMA220 I2C-based triaxial accelerometer sensor
	  family.

if BMA220

choice
	prompt "Trigger mode"
	default BMA220_TRIGGER_GLOBAL_THREAD
	help
	  Specify the type of triggering to be used by the driver.

config BMA220_TRIGGER_NONE
	bool "No trigger"

config BMA220_TRIGGER_GLOBAL_THREAD
	bool "Use global thread"
	depends on GPIO
	select BMA220_TRIGGER

config BMA220_TRIGGER_OWN_THREAD
	bool "Use own thread"
	depends on GPIO
	select BMA220_TRIGGER

endchoice

config BMA220_TRIGGER
	bool

config BMA220_THREAD_PRIORITY
	int "Thread priority"
	depends on BMA220_TRIGGER_OWN_THREAD
	default 10
	help
	  Priority of thread used by the driver to handle interrupts.

config BMA220_THREAD_STACK_SIZE
	int "Thread stack size"
	depends on BMA220_TRIGGER_OWN_THREAD
	default 1024
	help
	  Stack size of thread used by the driver to handle interrupts.

choice
	prompt "Acceleration measurement range"
	default BMA220_RANGE_2G
	help
	  Measurement range for acceleration values.

config BMA220_RANGE_2G
	bool "+/-2g"

config BMA220_RANGE_4G
	bool "+/-4g"

config BMA220_RANGE_8G
	bool "+/-8g"

config BMA220_RANGE_16G
	bool "+/-16g"

endchoice

choice
	prompt "Acceleration data filter bandwidth"
	default BMA220_BW_6
	help
	  Bandwidth of filtered acceleration data.

config BMA220_BW_1
	bool "32Hz"

config BMA220_BW_2
	bool "64HZ"

config BMA220_BW_3
	bool "125Hz"

config BMA220_BW_4
	bool "250Hz"

config BMA220_BW_5
	bool "500Hz"

config BMA220_BW_6
	bool "1000HZ"

endchoice

endif # BMA220
```

## bma220/zephyr/dts/bindings/bosch,bma220-i2c.yaml
```yaml
# SPDX-License-Identifier: Apache-2.0

description: |
  Bosch BMA220 triaxial acceleration sensor.

compatible: "bosch,bma220"

include: i2c-device.yaml

properties:
  int-gpios:
    type: phandle-array
    required: false
    description: |
      Identifies pin for the INT signal on the sensor.
```

## sim800l/zephyr/Kconfig
```kconfig
# SIM800L modem driver options

# SPDX-License-Identifier: Apache-2.0

menuconfig MODEM_SIM800L
	bool "Enable SIM800L modem driver"
	select MODEM_RECEIVER
	imply GPIO
	help
	  Choose this setting to enable
	  SIM800L modem driver.

if MODEM_SIM800L

config MODEM_SIM800L_RX_STACK_SIZE
	int "Size of the stack for the SIM800L modem driver RX thread"
	default 1024
	help
	  This stack is used by the SIM800L RX thread.

endif # MODEM_SIM800L
```

## sim800l/zephyr/dts/bindings/simcom,sim800l.yaml
```yaml
#
# SPDX-License-Identifier: Apache-2.0
#

description: SIM800L Modem

compatible: "simcom,sim800l"

include: uart-device.yaml

properties:
    label:
      required: true

    mdm-reset-gpios:
        type: phandle-array
        required: true
```
